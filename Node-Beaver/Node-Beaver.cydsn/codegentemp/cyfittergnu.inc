.ifndef INCLUDED_CYFITTERGNU_INC
.set INCLUDED_CYFITTERGNU_INC, 1
.include "cydevicegnu.inc"
.include "cydevicegnu_trm.inc"

/* emFile_1_Clock_1 */
.set emFile_1_Clock_1__CFG0, CYREG_CLKDIST_DCFG0_CFG0
.set emFile_1_Clock_1__CFG1, CYREG_CLKDIST_DCFG0_CFG1
.set emFile_1_Clock_1__CFG2, CYREG_CLKDIST_DCFG0_CFG2
.set emFile_1_Clock_1__CFG2_SRC_SEL_MASK, 0x07
.set emFile_1_Clock_1__INDEX, 0x00
.set emFile_1_Clock_1__PM_ACT_CFG, CYREG_PM_ACT_CFG2
.set emFile_1_Clock_1__PM_ACT_MSK, 0x01
.set emFile_1_Clock_1__PM_STBY_CFG, CYREG_PM_STBY_CFG2
.set emFile_1_Clock_1__PM_STBY_MSK, 0x01

/* emFile_1_miso0 */
.set emFile_1_miso0__0__MASK, 0x01
.set emFile_1_miso0__0__PC, CYREG_PRT5_PC0
.set emFile_1_miso0__0__PORT, 5
.set emFile_1_miso0__0__SHIFT, 0
.set emFile_1_miso0__AG, CYREG_PRT5_AG
.set emFile_1_miso0__AMUX, CYREG_PRT5_AMUX
.set emFile_1_miso0__BIE, CYREG_PRT5_BIE
.set emFile_1_miso0__BIT_MASK, CYREG_PRT5_BIT_MASK
.set emFile_1_miso0__BYP, CYREG_PRT5_BYP
.set emFile_1_miso0__CTL, CYREG_PRT5_CTL
.set emFile_1_miso0__DM0, CYREG_PRT5_DM0
.set emFile_1_miso0__DM1, CYREG_PRT5_DM1
.set emFile_1_miso0__DM2, CYREG_PRT5_DM2
.set emFile_1_miso0__DR, CYREG_PRT5_DR
.set emFile_1_miso0__INP_DIS, CYREG_PRT5_INP_DIS
.set emFile_1_miso0__LCD_COM_SEG, CYREG_PRT5_LCD_COM_SEG
.set emFile_1_miso0__LCD_EN, CYREG_PRT5_LCD_EN
.set emFile_1_miso0__MASK, 0x01
.set emFile_1_miso0__PORT, 5
.set emFile_1_miso0__PRT, CYREG_PRT5_PRT
.set emFile_1_miso0__PRTDSI__CAPS_SEL, CYREG_PRT5_CAPS_SEL
.set emFile_1_miso0__PRTDSI__DBL_SYNC_IN, CYREG_PRT5_DBL_SYNC_IN
.set emFile_1_miso0__PRTDSI__OE_SEL0, CYREG_PRT5_OE_SEL0
.set emFile_1_miso0__PRTDSI__OE_SEL1, CYREG_PRT5_OE_SEL1
.set emFile_1_miso0__PRTDSI__OUT_SEL0, CYREG_PRT5_OUT_SEL0
.set emFile_1_miso0__PRTDSI__OUT_SEL1, CYREG_PRT5_OUT_SEL1
.set emFile_1_miso0__PRTDSI__SYNC_OUT, CYREG_PRT5_SYNC_OUT
.set emFile_1_miso0__PS, CYREG_PRT5_PS
.set emFile_1_miso0__SHIFT, 0
.set emFile_1_miso0__SLW, CYREG_PRT5_SLW

/* emFile_1_mosi0 */
.set emFile_1_mosi0__0__MASK, 0x02
.set emFile_1_mosi0__0__PC, CYREG_PRT5_PC1
.set emFile_1_mosi0__0__PORT, 5
.set emFile_1_mosi0__0__SHIFT, 1
.set emFile_1_mosi0__AG, CYREG_PRT5_AG
.set emFile_1_mosi0__AMUX, CYREG_PRT5_AMUX
.set emFile_1_mosi0__BIE, CYREG_PRT5_BIE
.set emFile_1_mosi0__BIT_MASK, CYREG_PRT5_BIT_MASK
.set emFile_1_mosi0__BYP, CYREG_PRT5_BYP
.set emFile_1_mosi0__CTL, CYREG_PRT5_CTL
.set emFile_1_mosi0__DM0, CYREG_PRT5_DM0
.set emFile_1_mosi0__DM1, CYREG_PRT5_DM1
.set emFile_1_mosi0__DM2, CYREG_PRT5_DM2
.set emFile_1_mosi0__DR, CYREG_PRT5_DR
.set emFile_1_mosi0__INP_DIS, CYREG_PRT5_INP_DIS
.set emFile_1_mosi0__LCD_COM_SEG, CYREG_PRT5_LCD_COM_SEG
.set emFile_1_mosi0__LCD_EN, CYREG_PRT5_LCD_EN
.set emFile_1_mosi0__MASK, 0x02
.set emFile_1_mosi0__PORT, 5
.set emFile_1_mosi0__PRT, CYREG_PRT5_PRT
.set emFile_1_mosi0__PRTDSI__CAPS_SEL, CYREG_PRT5_CAPS_SEL
.set emFile_1_mosi0__PRTDSI__DBL_SYNC_IN, CYREG_PRT5_DBL_SYNC_IN
.set emFile_1_mosi0__PRTDSI__OE_SEL0, CYREG_PRT5_OE_SEL0
.set emFile_1_mosi0__PRTDSI__OE_SEL1, CYREG_PRT5_OE_SEL1
.set emFile_1_mosi0__PRTDSI__OUT_SEL0, CYREG_PRT5_OUT_SEL0
.set emFile_1_mosi0__PRTDSI__OUT_SEL1, CYREG_PRT5_OUT_SEL1
.set emFile_1_mosi0__PRTDSI__SYNC_OUT, CYREG_PRT5_SYNC_OUT
.set emFile_1_mosi0__PS, CYREG_PRT5_PS
.set emFile_1_mosi0__SHIFT, 1
.set emFile_1_mosi0__SLW, CYREG_PRT5_SLW

/* emFile_1_sclk0 */
.set emFile_1_sclk0__0__MASK, 0x04
.set emFile_1_sclk0__0__PC, CYREG_PRT5_PC2
.set emFile_1_sclk0__0__PORT, 5
.set emFile_1_sclk0__0__SHIFT, 2
.set emFile_1_sclk0__AG, CYREG_PRT5_AG
.set emFile_1_sclk0__AMUX, CYREG_PRT5_AMUX
.set emFile_1_sclk0__BIE, CYREG_PRT5_BIE
.set emFile_1_sclk0__BIT_MASK, CYREG_PRT5_BIT_MASK
.set emFile_1_sclk0__BYP, CYREG_PRT5_BYP
.set emFile_1_sclk0__CTL, CYREG_PRT5_CTL
.set emFile_1_sclk0__DM0, CYREG_PRT5_DM0
.set emFile_1_sclk0__DM1, CYREG_PRT5_DM1
.set emFile_1_sclk0__DM2, CYREG_PRT5_DM2
.set emFile_1_sclk0__DR, CYREG_PRT5_DR
.set emFile_1_sclk0__INP_DIS, CYREG_PRT5_INP_DIS
.set emFile_1_sclk0__LCD_COM_SEG, CYREG_PRT5_LCD_COM_SEG
.set emFile_1_sclk0__LCD_EN, CYREG_PRT5_LCD_EN
.set emFile_1_sclk0__MASK, 0x04
.set emFile_1_sclk0__PORT, 5
.set emFile_1_sclk0__PRT, CYREG_PRT5_PRT
.set emFile_1_sclk0__PRTDSI__CAPS_SEL, CYREG_PRT5_CAPS_SEL
.set emFile_1_sclk0__PRTDSI__DBL_SYNC_IN, CYREG_PRT5_DBL_SYNC_IN
.set emFile_1_sclk0__PRTDSI__OE_SEL0, CYREG_PRT5_OE_SEL0
.set emFile_1_sclk0__PRTDSI__OE_SEL1, CYREG_PRT5_OE_SEL1
.set emFile_1_sclk0__PRTDSI__OUT_SEL0, CYREG_PRT5_OUT_SEL0
.set emFile_1_sclk0__PRTDSI__OUT_SEL1, CYREG_PRT5_OUT_SEL1
.set emFile_1_sclk0__PRTDSI__SYNC_OUT, CYREG_PRT5_SYNC_OUT
.set emFile_1_sclk0__PS, CYREG_PRT5_PS
.set emFile_1_sclk0__SHIFT, 2
.set emFile_1_sclk0__SLW, CYREG_PRT5_SLW

/* emFile_1_SPI0_BSPIM */
.set emFile_1_SPI0_BSPIM_BitCounter__16BIT_CONTROL_AUX_CTL_REG, CYREG_B1_UDB09_10_ACTL
.set emFile_1_SPI0_BSPIM_BitCounter__16BIT_CONTROL_CONTROL_REG, CYREG_B1_UDB09_10_CTL
.set emFile_1_SPI0_BSPIM_BitCounter__16BIT_CONTROL_COUNT_REG, CYREG_B1_UDB09_10_CTL
.set emFile_1_SPI0_BSPIM_BitCounter__16BIT_COUNT_CONTROL_REG, CYREG_B1_UDB09_10_CTL
.set emFile_1_SPI0_BSPIM_BitCounter__16BIT_COUNT_COUNT_REG, CYREG_B1_UDB09_10_CTL
.set emFile_1_SPI0_BSPIM_BitCounter__16BIT_MASK_MASK_REG, CYREG_B1_UDB09_10_MSK
.set emFile_1_SPI0_BSPIM_BitCounter__16BIT_MASK_PERIOD_REG, CYREG_B1_UDB09_10_MSK
.set emFile_1_SPI0_BSPIM_BitCounter__16BIT_PERIOD_MASK_REG, CYREG_B1_UDB09_10_MSK
.set emFile_1_SPI0_BSPIM_BitCounter__16BIT_PERIOD_PERIOD_REG, CYREG_B1_UDB09_10_MSK
.set emFile_1_SPI0_BSPIM_BitCounter__CONTROL_AUX_CTL_REG, CYREG_B1_UDB09_ACTL
.set emFile_1_SPI0_BSPIM_BitCounter__CONTROL_REG, CYREG_B1_UDB09_CTL
.set emFile_1_SPI0_BSPIM_BitCounter__CONTROL_ST_REG, CYREG_B1_UDB09_ST_CTL
.set emFile_1_SPI0_BSPIM_BitCounter__COUNT_REG, CYREG_B1_UDB09_CTL
.set emFile_1_SPI0_BSPIM_BitCounter__COUNT_ST_REG, CYREG_B1_UDB09_ST_CTL
.set emFile_1_SPI0_BSPIM_BitCounter__MASK_CTL_AUX_CTL_REG, CYREG_B1_UDB09_MSK_ACTL
.set emFile_1_SPI0_BSPIM_BitCounter__PER_CTL_AUX_CTL_REG, CYREG_B1_UDB09_MSK_ACTL
.set emFile_1_SPI0_BSPIM_BitCounter__PERIOD_REG, CYREG_B1_UDB09_MSK
.set emFile_1_SPI0_BSPIM_BitCounter_ST__16BIT_STATUS_AUX_CTL_REG, CYREG_B1_UDB09_10_ACTL
.set emFile_1_SPI0_BSPIM_BitCounter_ST__16BIT_STATUS_REG, CYREG_B1_UDB09_10_ST
.set emFile_1_SPI0_BSPIM_BitCounter_ST__MASK_REG, CYREG_B1_UDB09_MSK
.set emFile_1_SPI0_BSPIM_BitCounter_ST__MASK_ST_AUX_CTL_REG, CYREG_B1_UDB09_MSK_ACTL
.set emFile_1_SPI0_BSPIM_BitCounter_ST__PER_ST_AUX_CTL_REG, CYREG_B1_UDB09_MSK_ACTL
.set emFile_1_SPI0_BSPIM_BitCounter_ST__STATUS_AUX_CTL_REG, CYREG_B1_UDB09_ACTL
.set emFile_1_SPI0_BSPIM_BitCounter_ST__STATUS_CNT_REG, CYREG_B1_UDB09_ST_CTL
.set emFile_1_SPI0_BSPIM_BitCounter_ST__STATUS_CONTROL_REG, CYREG_B1_UDB09_ST_CTL
.set emFile_1_SPI0_BSPIM_BitCounter_ST__STATUS_REG, CYREG_B1_UDB09_ST
.set emFile_1_SPI0_BSPIM_RxStsReg__16BIT_STATUS_AUX_CTL_REG, CYREG_B1_UDB10_11_ACTL
.set emFile_1_SPI0_BSPIM_RxStsReg__16BIT_STATUS_REG, CYREG_B1_UDB10_11_ST
.set emFile_1_SPI0_BSPIM_RxStsReg__4__MASK, 0x10
.set emFile_1_SPI0_BSPIM_RxStsReg__4__POS, 4
.set emFile_1_SPI0_BSPIM_RxStsReg__5__MASK, 0x20
.set emFile_1_SPI0_BSPIM_RxStsReg__5__POS, 5
.set emFile_1_SPI0_BSPIM_RxStsReg__6__MASK, 0x40
.set emFile_1_SPI0_BSPIM_RxStsReg__6__POS, 6
.set emFile_1_SPI0_BSPIM_RxStsReg__MASK, 0x70
.set emFile_1_SPI0_BSPIM_RxStsReg__MASK_REG, CYREG_B1_UDB10_MSK
.set emFile_1_SPI0_BSPIM_RxStsReg__STATUS_AUX_CTL_REG, CYREG_B1_UDB10_ACTL
.set emFile_1_SPI0_BSPIM_RxStsReg__STATUS_REG, CYREG_B1_UDB10_ST
.set emFile_1_SPI0_BSPIM_sR8_Dp_u0__16BIT_A0_REG, CYREG_B1_UDB09_10_A0
.set emFile_1_SPI0_BSPIM_sR8_Dp_u0__16BIT_A1_REG, CYREG_B1_UDB09_10_A1
.set emFile_1_SPI0_BSPIM_sR8_Dp_u0__16BIT_D0_REG, CYREG_B1_UDB09_10_D0
.set emFile_1_SPI0_BSPIM_sR8_Dp_u0__16BIT_D1_REG, CYREG_B1_UDB09_10_D1
.set emFile_1_SPI0_BSPIM_sR8_Dp_u0__16BIT_DP_AUX_CTL_REG, CYREG_B1_UDB09_10_ACTL
.set emFile_1_SPI0_BSPIM_sR8_Dp_u0__16BIT_F0_REG, CYREG_B1_UDB09_10_F0
.set emFile_1_SPI0_BSPIM_sR8_Dp_u0__16BIT_F1_REG, CYREG_B1_UDB09_10_F1
.set emFile_1_SPI0_BSPIM_sR8_Dp_u0__A0_A1_REG, CYREG_B1_UDB09_A0_A1
.set emFile_1_SPI0_BSPIM_sR8_Dp_u0__A0_REG, CYREG_B1_UDB09_A0
.set emFile_1_SPI0_BSPIM_sR8_Dp_u0__A1_REG, CYREG_B1_UDB09_A1
.set emFile_1_SPI0_BSPIM_sR8_Dp_u0__D0_D1_REG, CYREG_B1_UDB09_D0_D1
.set emFile_1_SPI0_BSPIM_sR8_Dp_u0__D0_REG, CYREG_B1_UDB09_D0
.set emFile_1_SPI0_BSPIM_sR8_Dp_u0__D1_REG, CYREG_B1_UDB09_D1
.set emFile_1_SPI0_BSPIM_sR8_Dp_u0__DP_AUX_CTL_REG, CYREG_B1_UDB09_ACTL
.set emFile_1_SPI0_BSPIM_sR8_Dp_u0__F0_F1_REG, CYREG_B1_UDB09_F0_F1
.set emFile_1_SPI0_BSPIM_sR8_Dp_u0__F0_REG, CYREG_B1_UDB09_F0
.set emFile_1_SPI0_BSPIM_sR8_Dp_u0__F1_REG, CYREG_B1_UDB09_F1
.set emFile_1_SPI0_BSPIM_sR8_Dp_u0__MSK_DP_AUX_CTL_REG, CYREG_B1_UDB09_MSK_ACTL
.set emFile_1_SPI0_BSPIM_sR8_Dp_u0__PER_DP_AUX_CTL_REG, CYREG_B1_UDB09_MSK_ACTL
.set emFile_1_SPI0_BSPIM_TxStsReg__0__MASK, 0x01
.set emFile_1_SPI0_BSPIM_TxStsReg__0__POS, 0
.set emFile_1_SPI0_BSPIM_TxStsReg__1__MASK, 0x02
.set emFile_1_SPI0_BSPIM_TxStsReg__1__POS, 1
.set emFile_1_SPI0_BSPIM_TxStsReg__16BIT_STATUS_AUX_CTL_REG, CYREG_B1_UDB08_09_ACTL
.set emFile_1_SPI0_BSPIM_TxStsReg__16BIT_STATUS_REG, CYREG_B1_UDB08_09_ST
.set emFile_1_SPI0_BSPIM_TxStsReg__2__MASK, 0x04
.set emFile_1_SPI0_BSPIM_TxStsReg__2__POS, 2
.set emFile_1_SPI0_BSPIM_TxStsReg__3__MASK, 0x08
.set emFile_1_SPI0_BSPIM_TxStsReg__3__POS, 3
.set emFile_1_SPI0_BSPIM_TxStsReg__4__MASK, 0x10
.set emFile_1_SPI0_BSPIM_TxStsReg__4__POS, 4
.set emFile_1_SPI0_BSPIM_TxStsReg__MASK, 0x1F
.set emFile_1_SPI0_BSPIM_TxStsReg__MASK_REG, CYREG_B1_UDB08_MSK
.set emFile_1_SPI0_BSPIM_TxStsReg__STATUS_AUX_CTL_REG, CYREG_B1_UDB08_ACTL
.set emFile_1_SPI0_BSPIM_TxStsReg__STATUS_REG, CYREG_B1_UDB08_ST

/* emFile_1_SPI0_CS */
.set emFile_1_SPI0_CS__0__MASK, 0x08
.set emFile_1_SPI0_CS__0__PC, CYREG_PRT5_PC3
.set emFile_1_SPI0_CS__0__PORT, 5
.set emFile_1_SPI0_CS__0__SHIFT, 3
.set emFile_1_SPI0_CS__AG, CYREG_PRT5_AG
.set emFile_1_SPI0_CS__AMUX, CYREG_PRT5_AMUX
.set emFile_1_SPI0_CS__BIE, CYREG_PRT5_BIE
.set emFile_1_SPI0_CS__BIT_MASK, CYREG_PRT5_BIT_MASK
.set emFile_1_SPI0_CS__BYP, CYREG_PRT5_BYP
.set emFile_1_SPI0_CS__CTL, CYREG_PRT5_CTL
.set emFile_1_SPI0_CS__DM0, CYREG_PRT5_DM0
.set emFile_1_SPI0_CS__DM1, CYREG_PRT5_DM1
.set emFile_1_SPI0_CS__DM2, CYREG_PRT5_DM2
.set emFile_1_SPI0_CS__DR, CYREG_PRT5_DR
.set emFile_1_SPI0_CS__INP_DIS, CYREG_PRT5_INP_DIS
.set emFile_1_SPI0_CS__LCD_COM_SEG, CYREG_PRT5_LCD_COM_SEG
.set emFile_1_SPI0_CS__LCD_EN, CYREG_PRT5_LCD_EN
.set emFile_1_SPI0_CS__MASK, 0x08
.set emFile_1_SPI0_CS__PORT, 5
.set emFile_1_SPI0_CS__PRT, CYREG_PRT5_PRT
.set emFile_1_SPI0_CS__PRTDSI__CAPS_SEL, CYREG_PRT5_CAPS_SEL
.set emFile_1_SPI0_CS__PRTDSI__DBL_SYNC_IN, CYREG_PRT5_DBL_SYNC_IN
.set emFile_1_SPI0_CS__PRTDSI__OE_SEL0, CYREG_PRT5_OE_SEL0
.set emFile_1_SPI0_CS__PRTDSI__OE_SEL1, CYREG_PRT5_OE_SEL1
.set emFile_1_SPI0_CS__PRTDSI__OUT_SEL0, CYREG_PRT5_OUT_SEL0
.set emFile_1_SPI0_CS__PRTDSI__OUT_SEL1, CYREG_PRT5_OUT_SEL1
.set emFile_1_SPI0_CS__PRTDSI__SYNC_OUT, CYREG_PRT5_SYNC_OUT
.set emFile_1_SPI0_CS__PS, CYREG_PRT5_PS
.set emFile_1_SPI0_CS__SHIFT, 3
.set emFile_1_SPI0_CS__SLW, CYREG_PRT5_SLW

/* Miscellaneous */
.set BCLK__BUS_CLK__HZ, 24000000
.set BCLK__BUS_CLK__KHZ, 24000
.set BCLK__BUS_CLK__MHZ, 24
.set CYDEV_CHIP_DIE_LEOPARD, 1
.set CYDEV_CHIP_DIE_PANTHER, 4
.set CYDEV_CHIP_DIE_PSOC4A, 2
.set CYDEV_CHIP_DIE_PSOC5LP, 5
.set CYDEV_CHIP_DIE_UNKNOWN, 0
.set CYDEV_CHIP_FAMILY_PSOC3, 1
.set CYDEV_CHIP_FAMILY_PSOC4, 2
.set CYDEV_CHIP_FAMILY_PSOC5, 3
.set CYDEV_CHIP_FAMILY_UNKNOWN, 0
.set CYDEV_CHIP_FAMILY_USED, CYDEV_CHIP_FAMILY_PSOC5
.set CYDEV_CHIP_JTAG_ID, 0x2E123069
.set CYDEV_CHIP_MEMBER_3A, 1
.set CYDEV_CHIP_MEMBER_4A, 2
.set CYDEV_CHIP_MEMBER_4D, 3
.set CYDEV_CHIP_MEMBER_5A, 4
.set CYDEV_CHIP_MEMBER_5B, 5
.set CYDEV_CHIP_MEMBER_UNKNOWN, 0
.set CYDEV_CHIP_MEMBER_USED, CYDEV_CHIP_MEMBER_5B
.set CYDEV_CHIP_DIE_EXPECT, CYDEV_CHIP_MEMBER_USED
.set CYDEV_CHIP_DIE_ACTUAL, CYDEV_CHIP_DIE_EXPECT
.set CYDEV_CHIP_REV_LEOPARD_ES1, 0
.set CYDEV_CHIP_REV_LEOPARD_ES2, 1
.set CYDEV_CHIP_REV_LEOPARD_ES3, 3
.set CYDEV_CHIP_REV_LEOPARD_PRODUCTION, 3
.set CYDEV_CHIP_REV_PANTHER_ES0, 0
.set CYDEV_CHIP_REV_PANTHER_ES1, 1
.set CYDEV_CHIP_REV_PANTHER_PRODUCTION, 1
.set CYDEV_CHIP_REV_PSOC4A_ES0, 17
.set CYDEV_CHIP_REV_PSOC4A_PRODUCTION, 17
.set CYDEV_CHIP_REV_PSOC5LP_ES0, 0
.set CYDEV_CHIP_REV_PSOC5LP_PRODUCTION, 0
.set CYDEV_CHIP_REVISION_3A_ES1, 0
.set CYDEV_CHIP_REVISION_3A_ES2, 1
.set CYDEV_CHIP_REVISION_3A_ES3, 3
.set CYDEV_CHIP_REVISION_3A_PRODUCTION, 3
.set CYDEV_CHIP_REVISION_4A_ES0, 17
.set CYDEV_CHIP_REVISION_4A_PRODUCTION, 17
.set CYDEV_CHIP_REVISION_4D_ES0, 0
.set CYDEV_CHIP_REVISION_4D_PRODUCTION, 0
.set CYDEV_CHIP_REVISION_5A_ES0, 0
.set CYDEV_CHIP_REVISION_5A_ES1, 1
.set CYDEV_CHIP_REVISION_5A_PRODUCTION, 1
.set CYDEV_CHIP_REVISION_5B_ES0, 0
.set CYDEV_CHIP_REVISION_5B_PRODUCTION, 0
.set CYDEV_CHIP_REVISION_USED, CYDEV_CHIP_REVISION_5B_PRODUCTION
.set CYDEV_CHIP_REV_EXPECT, CYDEV_CHIP_REVISION_USED
.set CYDEV_CONFIG_FASTBOOT_ENABLED, 1
.set CYDEV_CONFIG_UNUSED_IO_AllowButWarn, 0
.set CYDEV_CONFIG_UNUSED_IO, CYDEV_CONFIG_UNUSED_IO_AllowButWarn
.set CYDEV_CONFIG_UNUSED_IO_AllowWithInfo, 1
.set CYDEV_CONFIG_UNUSED_IO_Disallowed, 2
.set CYDEV_CONFIGURATION_COMPRESSED, 1
.set CYDEV_CONFIGURATION_DMA, 0
.set CYDEV_CONFIGURATION_ECC, 1
.set CYDEV_CONFIGURATION_IMOENABLED, CYDEV_CONFIG_FASTBOOT_ENABLED
.set CYDEV_CONFIGURATION_MODE_COMPRESSED, 0
.set CYDEV_CONFIGURATION_MODE, CYDEV_CONFIGURATION_MODE_COMPRESSED
.set CYDEV_CONFIGURATION_MODE_DMA, 2
.set CYDEV_CONFIGURATION_MODE_UNCOMPRESSED, 1
.set CYDEV_DEBUG_ENABLE_MASK, 0x20
.set CYDEV_DEBUG_ENABLE_REGISTER, CYREG_MLOGIC_DEBUG
.set CYDEV_DEBUGGING_DPS_Disable, 3
.set CYDEV_DEBUGGING_DPS_JTAG_4, 1
.set CYDEV_DEBUGGING_DPS_JTAG_5, 0
.set CYDEV_DEBUGGING_DPS_SWD, 2
.set CYDEV_DEBUGGING_DPS_SWD_SWV, 6
.set CYDEV_DEBUGGING_DPS, CYDEV_DEBUGGING_DPS_SWD_SWV
.set CYDEV_DEBUGGING_ENABLE, 1
.set CYDEV_DEBUGGING_XRES, 0
.set CYDEV_DMA_CHANNELS_AVAILABLE, 24
.set CYDEV_ECC_ENABLE, 0
.set CYDEV_HEAP_SIZE, 0x1000
.set CYDEV_INSTRUCT_CACHE_ENABLED, 1
.set CYDEV_INTR_RISING, 0x00000000
.set CYDEV_PROJ_TYPE, 0
.set CYDEV_PROJ_TYPE_BOOTLOADER, 1
.set CYDEV_PROJ_TYPE_LOADABLE, 2
.set CYDEV_PROJ_TYPE_MULTIAPPBOOTLOADER, 3
.set CYDEV_PROJ_TYPE_STANDARD, 0
.set CYDEV_PROTECTION_ENABLE, 0
.set CYDEV_STACK_SIZE, 0x4000
.set CYDEV_USE_BUNDLED_CMSIS, 1
.set CYDEV_VARIABLE_VDDA, 0
.set CYDEV_VDDA_MV, 5000
.set CYDEV_VDDD_MV, 5000
.set CYDEV_VDDIO0_MV, 5000
.set CYDEV_VDDIO1_MV, 5000
.set CYDEV_VDDIO2_MV, 5000
.set CYDEV_VDDIO3_MV, 5000
.set CYDEV_VIO0, 5
.set CYDEV_VIO0_MV, 5000
.set CYDEV_VIO1, 5
.set CYDEV_VIO1_MV, 5000
.set CYDEV_VIO2, 5
.set CYDEV_VIO2_MV, 5000
.set CYDEV_VIO3, 5
.set CYDEV_VIO3_MV, 5000
.set CYIPBLOCK_ARM_CM3_VERSION, 0
.set CYIPBLOCK_P3_ANAIF_VERSION, 0
.set CYIPBLOCK_P3_CAN_VERSION, 0
.set CYIPBLOCK_P3_CAPSENSE_VERSION, 0
.set CYIPBLOCK_P3_COMP_VERSION, 0
.set CYIPBLOCK_P3_DECIMATOR_VERSION, 0
.set CYIPBLOCK_P3_DFB_VERSION, 0
.set CYIPBLOCK_P3_DMA_VERSION, 0
.set CYIPBLOCK_P3_DRQ_VERSION, 0
.set CYIPBLOCK_P3_DSM_VERSION, 0
.set CYIPBLOCK_P3_EMIF_VERSION, 0
.set CYIPBLOCK_P3_I2C_VERSION, 0
.set CYIPBLOCK_P3_LCD_VERSION, 0
.set CYIPBLOCK_P3_LPF_VERSION, 0
.set CYIPBLOCK_P3_OPAMP_VERSION, 0
.set CYIPBLOCK_P3_PM_VERSION, 0
.set CYIPBLOCK_P3_SCCT_VERSION, 0
.set CYIPBLOCK_P3_TIMER_VERSION, 0
.set CYIPBLOCK_P3_USB_VERSION, 0
.set CYIPBLOCK_P3_VIDAC_VERSION, 0
.set CYIPBLOCK_P3_VREF_VERSION, 0
.set CYIPBLOCK_S8_GPIO_VERSION, 0
.set CYIPBLOCK_S8_IRQ_VERSION, 0
.set CYIPBLOCK_S8_SAR_VERSION, 0
.set CYIPBLOCK_S8_SIO_VERSION, 0
.set CYIPBLOCK_S8_UDB_VERSION, 0
.set DMA_CHANNELS_USED__MASK0, 0x00000000
.set CYDEV_BOOTLOADER_ENABLE, 0
.endif
